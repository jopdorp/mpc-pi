## Config.in
```kconfig
menu "MPC Pi packages"

source "$BR2_EXTERNAL_MPC_PI_PATH/package/mpc-mk1-display/Config.in"

endmenu
```

## package/mame-mpc/Config.in
```kconfig
config BR2_PACKAGE_MAME_MPC
	bool "mame-mpc"
	depends on BR2_TOOLCHAIN_HAS_THREADS
	depends on BR2_INSTALL_LIBSTDCPP
	depends on BR2_TOOLCHAIN_GCC_AT_LEAST_10
	depends on BR2_USE_MMU
	select BR2_PACKAGE_SDL2
	select BR2_PACKAGE_SDL2_TTF
	select BR2_PACKAGE_FONTCONFIG
	select BR2_PACKAGE_FREETYPE
	select BR2_PACKAGE_ZLIB
	select BR2_PACKAGE_EXPAT
	select BR2_PACKAGE_FLAC
	select BR2_PACKAGE_SQLITE
	select BR2_PACKAGE_PORTMIDI
	select BR2_PACKAGE_ALSA_LIB
	help
	  MAME restricted to the Akai MPC drivers, with this project's
	  ordered patch stack applied. Builds only the mpc subtarget.

	  The stack is read from patches/mame in the external tree, so the
	  desktop build and the appliance build stay in step.

comment "mame-mpc needs a toolchain with threads, C++, gcc >= 10"
	depends on !BR2_TOOLCHAIN_HAS_THREADS || !BR2_INSTALL_LIBSTDCPP \
		|| !BR2_TOOLCHAIN_GCC_AT_LEAST_10
```

## package/mpc-mk1-display/Config.in
```kconfig
config BR2_PACKAGE_MPC_MK1_DISPLAY
	bool "mpc-mk1-display"
	depends on BR2_PACKAGE_PYTHON3
	select BR2_PACKAGE_PYTHON_PYUSB
	help
	  Pushes the emulated MPC2000XL panel LCD to a Native Instruments
	  Maschine MK1 over USB, reading frames from the export file that
	  patch 0039 writes.

comment "mpc-mk1-display needs python3"
	depends on !BR2_PACKAGE_PYTHON3
```
